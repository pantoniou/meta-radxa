## conf/machine/rockpi-s-rk3308.conf
```bitbake
#@TYPE: Machine
#@NAME: RockPi-S machine
#@DESCRIPTION: RockPi-S development board config file

SOC_FAMILY = "rk3308"

DEFAULTTUNE ?= "cortexa35-crypto"
require conf/machine/include/tune-cortexa35.inc
require conf/machine/include/soc-family.inc

MACHINEOVERRIDES =. "mali-gpu:mali-midgard:"

PREFERRED_PROVIDER_virtual/kernel = "linux-rockpi-s"
PREFERRED_VERSION_linux-rockchip = "4.4"

SERIAL_CONSOLES = "1500000;ttyS0"
KERNEL_IMAGETYPE = "Image"
KBUILD_DEFCONFIG = "rk3308_linux_defconfig"

PREFERRED_PROVIDER_virtual/bootloader ?= "u-boot-rockpi-s"

KERNEL_DEVICETREE = "rockchip/rk3308-rock-pi-s.dtb"
UBOOT_MACHINE = "rock-pi-s-rk3308_defconfig"

MACHINE_ESSENTIAL_EXTRA_RRECOMMENDS += "\
   kernel-modules \
   rtl-tools \
   rkwifibt-firmware-rtl8723ds-bt \
"
IMAGE_FSTYPES += "rockchip-radxa-gpt-img"
IMAGE_CLASSES += "rockchip-radxa-gpt-img"

WKS_FILE ?= "sdimage-rockpi-s.wks"

do_image_wic[depends] += " \
   radxa-binaries:do_deploy \
   "

IMAGE_BOOT_FILES ?= " \
   boot.cmd \
   boot.scr \
   Image \
   rk3308-rock-pi-s.dtb \
   uEnv.txt \
   overlays/rk3308-console-on-uart0.dtbo \
   overlays/rk3308-console-on-uart1.dtbo \
   overlays/rk3308-console-on-uart2.dtbo \
   overlays/rk3308-i2c0.dtbo \
   overlays/rk3308-i2c1.dtbo \
   overlays/rk3308-i2c2.dtbo \
   overlays/rk3308-i2c3.dtbo \
   overlays/rk3308-pwm1.dtbo \
   overlays/rk3308-pwm2.dtbo \
   overlays/rk3308-pwm3.dtbo \
   overlays/rk3308-spi-spidev.dtbo \
   overlays/rk3308-uart0.dtbo \
   overlays/rk3308-uart1.dtbo \
   overlays/rk3308-uart2.dtbo \
   overlays/rk3308-w1-gpio.dtbo \
   overlays/rockpis-spi2-waveshare35b-v2.dtbo \
   overlays/rockpis-spi2-waveshare35c.dtbo \
   overlays/rockchip-fixup.scr \
   "
```

## wic/sdimage-rockpi-4b.wks
```
# short-description: Create RockPI-4b SD card image
# long-description: Creates a partitioned SD card image for use with
# RockPI-4b. Boot files are located in the first vfat partition.

bootloader --ptable gpt

# stage 1 loader (at 32k offset)
part /loader1 --source rawcopy --sourceparams="file=idbloader.img" --ondisk mmcblk --align=32

# stage 2 loader (uboot) (at 8M offset)
part /loader2 --source rawcopy --sourceparams="file=u-boot.img" --fixed-size=4M --ondisk mmcblk --align=8192

# atf (at 12M offset)
part /trust --source rawcopy --sourceparams="file=trust.img" --fixed-size=4M --ondisk mmcblk --align=12288

# boot
part /boot --source bootimg-partition --fixed-size=112M --ondisk mmcblk --fstype=vfat --label boot --active --align=16384 --uuid="C12A7328-F81F-11D2-BA4B-00A0C93EC93B" --part-type="C12A7328-F81F-11D2-BA4B-00A0C93EC93B"

# root at 128MB
part / --source rootfs --ondisk mmcblk --fstype=vfat --fstype=ext4 --label rootfs --align 131072 --uuid="B921B045-1DF0-41C3-AF44-4C6F280D3FAE" --part-type="B921B045-1DF0-41C3-AF44-4C6F280D3FAE"
```
